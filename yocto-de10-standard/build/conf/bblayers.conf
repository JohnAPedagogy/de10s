## yocto-de10-standard/build/conf/bblayers.conf
```bitbake
# POKY_BBLAYERS_CONF_VERSION is increased each time build/conf/bblayers.conf
# changes incompatibly
POKY_BBLAYERS_CONF_VERSION = "2"

BBPATH = "${TOPDIR}"
BBFILES ?= ""

BBLAYERS ?= " \
  /home/its/tools/yocto/de10/yocto-de10-standard/poky/meta \
  /home/its/tools/yocto/de10/yocto-de10-standard/poky/meta-poky \
  /home/its/tools/yocto/de10/yocto-de10-standard/poky/meta-yocto-bsp \
  /home/its/tools/yocto/de10/yocto-de10-standard/meta-openembedded/meta-oe \
  /home/its/tools/yocto/de10/yocto-de10-standard/meta-openembedded/meta-python \
  /home/its/tools/yocto/de10/yocto-de10-standard/meta-openembedded/meta-networking \
  /home/its/tools/yocto/de10/yocto-de10-standard/meta-intelfpga \
  /home/its/tools/yocto/de10/yocto-de10-standard/meta-de10-standard \
  "
```
